## config/west.yml
```yaml
manifest:
  remotes:
    - name: Mac-D-Broski
      url-base: https://github.com/Mac-D-Broski
  projects:
    - name: ZMK-Config
      remote: Mac-D-Broski
      revision: main
      import: config/west.yml
  self:
    path: config
```
